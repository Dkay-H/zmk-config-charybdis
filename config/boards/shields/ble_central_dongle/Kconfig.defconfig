## config/boards/shields/ble_central_dongle/Kconfig.defconfig
```kconfig
if SHIELD_BLE_CENTRAL_DONGLE

config ZMK_BLE_CENTRAL
    default y

endif
source "boards/shields/ble_central_dongle/Kconfig.defconfig"
```

## config/boards/shields/ble_central_dongle/Kconfig.shield
```kconfig
config SHIELD_BLE_CENTRAL_DONGLE
    bool "BLE Central Dongle"
    source "boards/shields/ble_central_dongle/Kconfig.shield"
```

## config/west.yml
```yaml
manifest:
  remotes:
    - name: zmkfirmware
      url-base: https://github.com/zmkfirmware
    - name: englmaxi
      url-base: https://github.com/englmaxi
    - name: inorichi
      url-base: https://github.com/inorichi

  projects:
    - name: zmk
      remote: zmkfirmware
      revision: main
      import: app/west.yml
    - name: zmk-dongle-display
      remote: englmaxi
      revision: main
    - name: zmk-pmw3610-driver
      remote: inorichi
      revision: main
      import: app/west.yml   # ← 이 줄은 드라이버 repo에 west.yml이 있을 때만 필요, 없으면 생략

  self:
    path: config
```
